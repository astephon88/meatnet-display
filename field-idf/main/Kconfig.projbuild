## field-idf/main/Kconfig.projbuild
```kconfig
menu "MeatNet field unit"
    comment "Defaults for a unit's first boot; the web page changes them."
    comment "WiFi, the app unit address and the shared key are set on the web page only (setup network MeatNet-<serial>)."

    config MEATNET_SPLIT_PORT
        int "App unit TCP/UDP port"
        default 7389

    config MEATNET_SUPERVISION_PROBE_MS
        int "Link supervision timeout for probes and MEATERs (ms)"
        range 1000 32000
        default 6000
        help
            How long a link may go without hearing the peer before it is
            dropped. NimBLE's default is about 2.5 s; phones use 5 s or more.

    config MEATNET_SUPERVISION_NODE_MS
        int "Link supervision timeout for nodes (Gauge, Engine, Display) (ms)"
        range 1000 32000
        default 20000
        help
            A Giant Grill Gauge goes silent on the link for 8-20 s at times
            (its own WiFi and links compete for its radio); 20 s rides most
            of those out (as Android phones do), cutting drops to about a
            third versus 8 s.

    config MEATNET_PEER_LATENCY_MAX
        int "Highest peripheral latency to grant a peer"
        range 0 10
        default 0
        help
            Combustion devices ask for a 500 ms interval with latency 2 (they
            may skip two of every three connection events). Capping latency
            makes them answer every interval: more chances to hear them
            before the supervision timeout, at a small power cost.

    choice MEATNET_COEX
        prompt "WiFi/Bluetooth coexistence preference"
        default MEATNET_COEX_BT
        help
            Which side gets the shared 2.4 GHz radio when both need it.
            Bluetooth keeps far links alive; WiFi only carries a few KB/s here.

        config MEATNET_COEX_BT
            bool "Prefer Bluetooth"
        config MEATNET_COEX_BALANCE
            bool "Balance"
        config MEATNET_COEX_WIFI
            bool "Prefer WiFi"
    endchoice

    config MEATNET_SCREEN
        bool "Status screen on a GC9A01A round LCD"
        default y
        help
            App unit link, WiFi, links and devices heard. Pins default to the
            Waveshare ESP32-S3-LCD-1.28 (non-touch); check your board's
            schematic otherwise.

    if MEATNET_SCREEN
        config MEATNET_SCREEN_SCK
            int "Screen SPI clock pin"
            default 10
        config MEATNET_SCREEN_MOSI
            int "Screen SPI data (MOSI) pin"
            default 11
        config MEATNET_SCREEN_DC
            int "Screen data/command pin"
            default 8
        config MEATNET_SCREEN_CS
            int "Screen chip-select pin"
            default 9
        config MEATNET_SCREEN_RST
            int "Screen reset pin (-1 = none)"
            default 12
        config MEATNET_SCREEN_BL
            int "Screen backlight pin (-1 = none)"
            default 40
        config MEATNET_SCREEN_BRIGHTNESS
            int "Backlight brightness (%)"
            range 0 100
            default 80
    endif

endmenu
```
